## conf/layer.conf
```bitbake
# We have a conf and classes directory, add to BBPATH
BBPATH .= ":${LAYERDIR}"

# We have recipes-* directories, add to BBFILES
BBFILES += "${LAYERDIR}/recipes-*/*/*.bb \
            ${LAYERDIR}/recipes-*/*/*.bbappend"

BBFILE_COLLECTIONS += "meta-rpicustom"
BBFILE_PATTERN_meta-rpicustom = "^${LAYERDIR}/"
BBFILE_PRIORITY_meta-rpicustom = "6"

LAYERDEPENDS_meta-rpicustom = "core"
LAYERSERIES_COMPAT_meta-rpicustom = "dunfell"
```
